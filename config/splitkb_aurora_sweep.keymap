/*
 * Copyright (c) 2020 The ZMK Contributors
 *
 * SPDX-License-Identifier: MIT
 */


#include <behaviors.dtsi>
#include <dt-bindings/zmk/keys.h>
#include <dt-bindings/zmk/rgb.h>
#include <dt-bindings/zmk/outputs.h>
#include <dt-bindings/zmk/ext_power.h>

/*           34 Keys
╭──────────────╮ ╭──────────────╮
│ 0  1  2  3  4│ │ 5  6  7  8  9│
│10 11 12 13 14│ │15 16 17 18 19│
│20 21 22 23 24│ │25 26 27 28 29│
╰────────╮30 31│ │32 33╭────────╯
         ╰─────╯ ╰─────╯         */

#define ALP 0 // Alphabeth characters
#define SYM 1 // Symboles
#define NUM 2 // Numbers
#define CRD 3 // Layer for Word Chords
#define CMD 4 // layer for chording
#define FUN 5 // Function Keys
#define DAN 6 // DANGER!
#define LCK 7 // Lock KB
#define MOD 8 // layer which holds a mod key, e.g. for holeing alt in alt+tap

#include "definitions/definitions.dtsi"

#include "layers/alpha/colemak.dtsi"
#include "layers/symbols.dtsi"
#include "layers/numbers.dtsi"
#include "layers/chording_layer.dtsi"
#include "layers/command.dtsi"
#include "layers/function.dtsi"
#include "layers/danger.dtsi"
#include "layers/lock.dtsi"
#include "layers/hold_mod.dtsi"
#define CHORDLAYER CRD
#include "chording/chords.dtsi"


COMBO_NORMAL(to_Alpha, &to ALP, LTI RTI)
COMBO_NORMAL(mo_cmd, &mo CMD, LTI LTO)
COMBO_NORMAL(mo_fun, &mo FUN, RTI RTO)



&led_strip {
    chain-length = <23>;
};

&caps_word {
   continue-list = <UNDERSCORE MINUS BACKSPACE>;
};



